## main/Kconfig.projbuild
```kconfig
menu "ESP32 KVM"

    config KVM_ENABLE_OTA
        bool "Firmware update via web UI (OTA)"
        default y
        help
            Requires a partition table with two slots ota_0/ota_1.
            If the firmware does not fit in 1920 KB, disable this and
            use partitions_4mb_noota.csv.

    menu "Network"
        config KVM_UDP_PORT
            int "Default UDP input port"
            range 1 65535
            default 4210

        config KVM_DEFAULT_HOSTNAME
            string "Default device name in the tailnet"
            default "esp-kvm"

        config KVM_TS_MAX_PEERS
            int "Maximum active WireGuard peers"
            range 1 16
            default 4

        config KVM_SETUP_AP_PASSWORD
            string "Setup access point password (WPA2, >=8 characters)"
            default "kvmsetup"

        config KVM_WIFI_RETRY_MAX_MS
            int "Maximum delay between WiFi reconnect attempts, ms"
            default 10000
    endmenu

    menu "KVM"
        config KVM_WATCHDOG_MS
            int "Default link watchdog, ms"
            range 50 5000
            default 200

        config KVM_UDP_HZ_DEFAULT
            int "Nominal packet rate, Hz (for reference in the UI)"
            range 60 1000
            default 125
    endmenu

    menu "Board"
        config KVM_BOOT_BUTTON_GPIO
            int "BOOT button GPIO"
            default 0

        config KVM_FACTORY_RESET_HOLD_MS
            int "BOOT hold time for factory reset, ms"
            default 5000

        config KVM_LED_GPIO
            int "Status LED GPIO (-1 = none)"
            default 48

        config KVM_LED_WS2812
            bool "LED is an addressable WS2812 (RGB)"
            default y

        config KVM_LED_ACTIVE_LOW
            bool "Plain LED is active low"
            depends on !KVM_LED_WS2812
            default n
    endmenu

    menu "USB descriptor"
        config KVM_USB_VID
            hex "Vendor ID"
            default 0x303A
        config KVM_USB_PID
            hex "Product ID"
            default 0x4002
        config KVM_USB_MANUFACTURER
            string "Manufacturer"
            default "ESP32"
        config KVM_USB_PRODUCT
            string "Product"
            default "KVM Keyboard/Mouse"
    endmenu

endmenu
```
